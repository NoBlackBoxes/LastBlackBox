## boxes/systems/LBBOS/resources/buildroot/configs/LBB_defconfig
```kconfig
# Architecture
BR2_aarch64=y
BR2_cortex_a72=y
BR2_ARM_FPU_VFPV4=y

# Toolchain
BR2_CCACHE=y
BR2_OPTIMIZE_FAST=y
BR2_TOOLCHAIN_BUILDROOT_GLIBC=y
BR2_PACKAGE_GLIBC_UTILS=y
BR2_PACKAGE_HOST_LINUX_HEADERS_CUSTOM_5_7=y
BR2_TOOLCHAIN_BUILDROOT_CXX=y
BR2_TOOLCHAIN_BUILDROOT_FORTRAN=y
BR2_TOOLCHAIN_BUILDROOT_VENDOR="LBB"

# System
BR2_TARGET_GENERIC_HOSTNAME="LBB"
BR2_TARGET_GENERIC_ISSUE="LastBlackBox OS"
# BR2_TARGET_ENABLE_ROOT_LOGIN is not set
BR2_SYSTEM_DHCP="eth0"
BR2_ENABLE_LOCALE_WHITELIST="C en_GB"
BR2_PACKAGE_OVERRIDE_FILE="$(BR2_EXTERNAL_LBB_PATH)/configs/local.mk"
BR2_ROOTFS_USERS_TABLES="$(BR2_EXTERNAL_LBB_PATH)/board/LastBlackBox/common/users_tables"
BR2_ROOTFS_POST_BUILD_SCRIPT="$(BR2_EXTERNAL_LBB_PATH)/board/LastBlackBox/LBB/post-build.sh"
BR2_ROOTFS_POST_FAKEROOT_SCRIPT="$(BR2_EXTERNAL_LBB_PATH)/board/LastBlackBox/LBB/fakeroot.sh"

# Firmware
BR2_PACKAGE_LBB_FIRMWARE=y

# Filesystem
BR2_TARGET_ROOTFS_EXT2=y
BR2_TARGET_ROOTFS_EXT2_4=y
BR2_TARGET_ROOTFS_EXT2_LABEL="rootfs"
BR2_TARGET_ROOTFS_EXT2_SIZE="256M"
# BR2_TARGET_ROOTFS_TAR is not set

# Tools
BR2_PACKAGE_HOST_DOSFSTOOLS=y
BR2_PACKAGE_HOST_GENIMAGE=y
BR2_PACKAGE_HOST_MTOOLS=y

# Packages

## FFMPEG
BR2_PACKAGE_FFMPEG=y
BR2_PACKAGE_FFMPEG_GPL=y

## Mesa
BR2_PACKAGE_MESA3D=y
BR2_PACKAGE_MESA3D_GALLIUM_DRIVER_KMSRO=y
BR2_PACKAGE_MESA3D_GALLIUM_DRIVER_V3D=y
BR2_PACKAGE_MESA3D_GALLIUM_DRIVER_VC4=y
BR2_PACKAGE_MESA3D_DRI_DRIVER_SWRAST=y
BR2_PACKAGE_MESA3D_OPENGL_ES=y

## RNG tools
BR2_PACKAGE_RNG_TOOLS=y

## V4L
BR2_PACKAGE_LIBV4L=y
BR2_PACKAGE_LIBV4L_UTILS=y

## Openblas
BR2_PACKAGE_OPENBLAS=y

## Openssh
BR2_PACKAGE_OPENSSH=y

## Rsync
BR2_PACKAGE_RSYNC=y

## Sudo
BR2_PACKAGE_SUDO=y
```

## boxes/systems/lbbos/buildroot/resources/buildroot/package/LBB-firmware/Config.in
```kconfig
config BR2_PACKAGE_LBB_FIRMWARE
	bool "LBB-firmware"
	depends on BR2_aarch64
	help
	  LastBlackBox firmware for Raspberry Pi 4b

	  Pre-compiled binaries of the current bootloader and GPU
	  firmware

	  https://github.com/raspberrypi/firmware
```
